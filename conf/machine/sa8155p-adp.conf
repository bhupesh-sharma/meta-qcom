## conf/machine/sa8155p-adp.conf
```bitbake
#@TYPE: Machine
#@NAME: SA8155P-ADP
#@DESCRIPTION: Machine configuration for the SA8155P-ADP development board, with Qualcomm Snapdragon 865 SM8250.

require conf/machine/include/qcom-sa8155p.inc

MACHINE_FEATURES = "usbhost usbgadget wifi bluetooth ext2"

KERNEL_IMAGETYPE ?= "Image.gz"
KERNEL_DEVICETREE ?= "qcom/sa8155p-adp.dtb"

SERIAL_CONSOLE ?= "115200 ttyMSM0"

MACHINE_ESSENTIAL_EXTRA_RRECOMMENDS += " \
    kernel-modules \
    ${@bb.utils.contains('DISTRO_FEATURES', 'bluetooth', 'linux-firmware-qca', '', d)} \
    ${@bb.utils.contains('DISTRO_FEATURES', 'opengl', 'mesa-driver-msm', '', d)} \
"
# linux-firmware-qcom-adreno-a650 

# /dev/sda6 is 'userdata' partition for adp board, so wipe it and use for our build
QCOM_BOOTIMG_ROOTFS ?= "/dev/sda6"

# UFS partitions setup with 4096 logical sector size
EXTRA_IMAGECMD_ext4 += " -b 4096 "
```
